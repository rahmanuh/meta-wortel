## conf/distro/wortel.conf
```bitbake
require conf/distro/poky.conf

DISTRO = "wortel"
DISTRO_NAME = "Wortel (Wortel Distro)"
DISTRO_VERSION = "1.0.0"
DISTRO_CODENAME = "Chantenay"

# Use systemd instead of sysvinit
DISTRO_FEATURES:append = " systemd "
DISTRO_FEATURES_BACKFILL_CONSIDERED = "sysvinit"
VIRTUAL-RUNTIME_init_manager = "systemd"
VIRTUAL-RUNTIME_initscripts = ""
```

## conf/layer.conf
```bitbake
# We have a conf and classes directory, add to BBPATH
BBPATH .= ":${LAYERDIR}"

# We have recipes-* directories, add to BBFILES
BBFILES += "${LAYERDIR}/recipes-*/*/*.bb \
            ${LAYERDIR}/recipes-*/*/*.bbappend"

BBFILE_COLLECTIONS += "meta-wortel"
BBFILE_PATTERN_meta-wortel = "^${LAYERDIR}/"
BBFILE_PRIORITY_meta-wortel = "6"

LAYERDEPENDS_meta-wortel = "core"
LAYERSERIES_COMPAT_meta-wortel = "kirkstone"
```

## wic/wortel.wks
```
# short-description: Create wortel SD card image
# long-description: Creates a partitioned SD card image for wortel distro
# Boot files are located in the first vfat partition.

part /boot --source bootimg-partition --ondisk mmcblk0 --fstype=vfat --label boot --active --align 4096 --size 20
part / --source rootfs --ondisk mmcblk0 --fstype=ext4 --label root --align 4096 --extra-space 64M
part /data --ondisk mmcblk0 --fstype=ext4 --label data --align 4096 --size 2048M
```
